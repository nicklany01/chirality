## config/boards/shields/chirality/Kconfig.defconfig
```kconfig
if SHIELD_CHIRALITY_LEFT
config ZMK_SPLIT_ROLE_CENTRAL
	default y
endif

if SHIELD_CHIRALITY_LEFT || SHIELD_CHIRALITY_RIGHT

config ZMK_KEYBOARD_NAME
	default "Chirality"

config ZMK_SPLIT
	default y

config ZMK_RGB_UNDERGLOW
	default y

config WS2812_STRIP
	default y

config BT
	default y

config ZMK_BLE
	default y

config EC11
	default y

config ZMK_DISPLAY
	default y

endif
```
